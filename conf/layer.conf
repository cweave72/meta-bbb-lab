## conf/layer.conf
```bitbake
# We have a conf and classes directory, add to BBPATH
BBPATH .= ":${LAYERDIR}"

# We have recipes-* directories, add to BBFILES
BBFILES += "${LAYERDIR}/recipes-*/*/*.bb \
            ${LAYERDIR}/recipes-*/*/*.bbappend"

BBFILE_COLLECTIONS += "meta-bbb-lab"
BBFILE_PATTERN_meta-bbb-lab = "^${LAYERDIR}/"
BBFILE_PRIORITY_meta-bbb-lab = "10"

LAYERDEPENDS_meta-bbb-lab = "core"
LAYERSERIES_COMPAT_meta-bbb-lab = "scarthgap"

# Kernel modules to be autoloaded.
KERNEL_MODULE_AUTOLOAD += "g_ether"
KERNEL_MODULE_PROBECONF += "g_ether"
module_conf_g_ether = "options g_ether dev_addr=c0:00:20:35:44:01 host_addr=c0:00:20:35:44:00"
```
